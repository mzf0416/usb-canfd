/* SPDX-License-Identifier: Apache-2.0 */
/*
 * USB FS（PA11 DM / PA12 DP）：CDC ACM 虚拟串口。
 * 48 MHz 域 = HSI48（见 clock.dtsi）。
 */
zephyr_udc0: &usb {
	pinctrl-0 = <&usb_dm_pa11 &usb_dp_pa12>;
	pinctrl-names = "default";
	status = "okay";

	cdc_acm_uart: cdc_acm_uart {
		compatible = "zephyr,cdc-acm-uart";
	};
};
