## boards/arm/st_g474_board/Kconfig.st_g474_board
```kconfig
# Copyright (c) 2016 Linaro Limited.
# SPDX-License-Identifier: Apache-2.0

config BOARD_ST_G474_BOARD
	select SOC_STM32G474XX
```

## boards/arm/st_g474_board/board.yml
```yaml
board:
  name: st_g474_board
  full_name: STM32G474 Custom Board
  vendor: st
  socs:
    - name: stm32g474xx
```

## boards/arm/st_g474_board/st_g474_board_defconfig
```kconfig
# Clock
CONFIG_CLOCK_CONTROL=y
CONFIG_CLOCK_CONTROL_STM32_CUBE=y

# 允许调试器在 Sleep/Stop 低功耗模式下保持 SWD 连接
CONFIG_STM32_ENABLE_DEBUG_SLEEP_STOP=y
```
